## boss1-app/testing/i2stest/Kconfig
```kconfig
#
# For a description of the syntax of this configuration file,
# see the file kconfig-language.txt in the NuttX tools repository.
#

config TESTING_I2STEST
    bool "i2stest"
    default n
    depends on AUDIO_I2SCHAR
    ---help---
        Enable I2S test (PDM microphone and speaker playback)

if TESTING_I2STEST

config TESTING_I2STEST_PROGNAME
    string "Program name"
    default "i2stest"
    ---help---
        This is the name of the program that will be used when the NSH ELF
        program is installed.

config TESTING_I2STEST_PRIORITY
    int "I2S test task priority"
    default 100

config TESTING_I2STEST_STACKSIZE
    int "I2S test stack size"
    default DEFAULT_TASK_STACKSIZE

config TESTING_I2STEST_TX
    bool "Enable I2S TX (playback) mode"
    default n
    ---help---
        Enable TX mode for I2S speaker playback testing

if TESTING_I2STEST_TX

config TESTING_I2STEST_TX_BUFFERS
    int "Number of TX buffers to send"
    default 5
    ---help---
        Number of audio buffers to send during TX test

config TESTING_I2STEST_TX_BUFSIZE
    int "TX buffer size in bytes"
    default 512
    ---help---
        Size of each TX buffer in bytes

config TESTING_I2STEST_FREQUENCY
    int "Sine wave frequency in Hz"
    default 440
    ---help---
        Frequency of the sine wave for TX playback test

endif # TESTING_I2STEST_TX

endif # TESTING_I2STEST
```

## boss1-app/watch-ui/apps/main/Kconfig
```kconfig
#
# For a description of the syntax of this configuration file,
# see the file kconfig-language.txt in the NuttX tools repository.
#

config WATCHUI
	tristate "\"Watch UI\" program"
	select OFFLINE_CXX_LIB
	default n
	---help---
		Enable the \"Watch UI\" program as init process.

if WATCHUI

config WATCHUI_PROGNAME
	string "Entry point of \"Watch UI\" program"
	default "watchui"
	---help---
		Entry point of \"Watch UI\" program.

config WATCHUI_PROGNAME_PRIORITY
	int "WATCH UI task priority"
	default 100

config WATCHUI_PROGNAME_STACKSIZE
	int "WATCH UI stack size"
	default DEFAULT_TASK_STACKSIZE

config OFFLINE_CXX_LIB
	bool "Offline C++ library"
	depends on LIBCXX
	default n
	---help---
		Enable the offline C++ library.

if OFFLINE_CXX_LIB

config OFFLINE_CXX_LIB_PATH
	string "Offline C++ library path"
	default "vendor/boss/xtensa/libcxx"
	---help---
		Offline C++ library path.

endif

endif
```

## boss1-app/watch-ui/framework/bluedroid/Kconfig
```kconfig
menu "Bluetooth"

    config BT_ENABLED
        bool "Bluetooth"
        help
            Select this option to enable Bluetooth and show the submenu with Bluetooth configuration choices.

    choice BT_HOST
        prompt "Host"
        depends on BT_ENABLED
        default BT_BLUEDROID_ENABLED
        help
            This helps to choose Bluetooth host stack

        config BT_BLUEDROID_ENABLED
            bool "Bluedroid - Dual-mode"
            help
                This option is recommended for classic Bluetooth or for dual-mode
                usecases

        config BT_NIMBLE_ENABLED
            bool "NimBLE - BLE only"
            help
                This option is recommended for BLE only usecases to save on memory

        config BT_CONTROLLER_ONLY
            depends on SOC_BT_SUPPORTED
            bool "Disabled"
            help
                This option is recommended when you want to communicate directly with the
                controller (without any host) or when you are using any other host stack
                not supported by Espressif (not mentioned here).

    endchoice

    menu "Bluedroid Options"
        depends on BT_BLUEDROID_ENABLED
        source "vendor/boss/app/boss1-app/watch-ui/framework/bluedroid/host/bluedroid/Kconfig.in"
    endmenu

    menu "NimBLE Options"
        depends on BT_NIMBLE_ENABLED
        source "vendor/boss/app/boss1-app/watch-ui/framework/bluedroid/host/nimble/Kconfig.in"
    endmenu

    menu "Common Options"
        visible if (BT_BLUEDROID_ENABLED || BT_NIMBLE_ENABLED)

        source "vendor/boss/app/boss1-app/watch-ui/framework/bluedroid/common/Kconfig.in"
    endmenu

    config BT_HCI_LOG_DEBUG_EN
        depends on BT_BLUEDROID_ENABLED || BT_NIMBLE_ENABLED
        bool "Enable Bluetooth HCI debug mode"
        default n
        help
            This option is used to enable bluetooth debug mode, which saves the hci layer data stream.

    config BT_HCI_LOG_DATA_BUFFER_SIZE
        depends on BT_HCI_LOG_DEBUG_EN
        int "Size of the cache used for HCI data in Bluetooth HCI debug mode (N*1024 bytes)"
        range 1 100
        default 5
        help
            This option is to configure the buffer size of the hci data steam cache in hci debug mode.
            This is a ring buffer, the new data will overwrite the oldest data if the buffer is full.

    config BT_HCI_LOG_ADV_BUFFER_SIZE
        depends on BT_HCI_LOG_DEBUG_EN
        int "Size of the cache used for adv report in Bluetooth HCI debug mode (N*1024 bytes)"
        range 1 100
        default 8
        help
            This option is to configure the buffer size of the hci adv report cache in hci debug mode.
            This is a ring buffer, the new data will overwrite the oldest data if the buffer is full.

endmenu

menuconfig BLE_MESH
    bool "ESP BLE Mesh Support"
    depends on BT_ENABLED
    help
        This option enables ESP BLE Mesh support. The specific features that are
        available may depend on other features that have been enabled in the
        stack, such as Bluetooth Support, Bluedroid Support & GATT support.

source "vendor/boss/app/boss1-app/watch-ui/framework/bluedroid/esp_ble_mesh/Kconfig.in"
```

## boss1-app/watch-ui/framework/test/Kconfig
```kconfig
#
# For a description of the syntax of this configuration file,
# see the file kconfig-language.txt in the NuttX tools repository.
#

menu "FRAMEWORK Test Code"

    config FRAMEWORK_TEST_ENABLED
        bool "\"Framework Test\" Application"
        help
            Select this option to enable framework test.
    
    if FRAMEWORK_TEST_ENABLED

        config FRAMEWORK_TEST_MODULE
            bool "Framework Test Module"
            default n
            ---help---
                Enable the \"Framework Test\" Module

        config FRAMEWORK_TEST_PROGNAME
            string "Program name"
            default "framework_test"
            ---help---
                This is the name of the program that will be used when the NSH ELF
                program is installed.

        config FRAMEWORK_TEST_PRIORITY
            int "FRAMEWORK_TEST task priority"
            default 100

        config FRAMEWORK_TEST_STACKSIZE
            int "FRAMEWORK_TEST stack size"
            default DEFAULT_TASK_STACKSIZE

        config BT_TEST_ENABLED
            bool "Bluetooth Test"
            help
                Select this option to enable Bluetooth Test.

    endif

    menu "Bluedroid Test Options"
        depends on BT_TEST_ENABLED
        source "vendor/boss/app/boss1-app/watch-ui/framework/test/test_bluedroid/Kconfig"
    endmenu

endmenu
```

## boss1-app/watch-ui/framework/test/test_bluedroid/Kconfig
```kconfig
#
# For a description of the syntax of this configuration file,
# see the file kconfig-language.txt in the NuttX tools repository.
#

config BT_TEST_OSI_ENABLED
    bool "OSI Test"
    help
        Select this option to enable bt's osi test.
if BT_TEST_OSI_ENABLED

config BT_TEST_OSI_MEMORY_ENABLED
    bool "OSI Memory Test"
    default n
    help
        Select this option to enable bt's osi memory test.

config BT_TEST_OSI_ALLOCATOR_ENABLED
    bool "OSI Allocator Test"
    default n
    help
        Select this option to enable bt's osi allocator test.

config BT_TEST_OSI_BUFFER_ENABLED
    bool "OSI Buffer Test"
    default n
    help
        Select this option to enable bt's osi buffer test.

config BT_TEST_OSI_LIST_ENABLED
    bool "OSI List Test"
    default n
    help
        Select this option to enable bt's osi list test.

config BT_TEST_OSI_CONFIG_ENABLED
    bool "OSI Config Test"
    default n
    help
        Select this option to enable bt's osi config test.

config BT_TEST_OSI_SEM_ENABLED
    bool "OSI Semaphore Test"
    default n
    help
        Select this option to enable bt's osi Semaphore test.

config BT_TEST_OSI_FUTURE_ENABLED
    bool "OSI Future Test"
    default n
    help
        Select this option to enable bt's osi Future test.

config BT_TEST_OSI_THREAD_ENABLED
    bool "OSI Thread Test"
    default n
    help
        Select this option to enable bt's osi Thread test.

config BT_TEST_OSI_EVENT_BITS_GROUPS_ENABLED
    bool "OSI EventBitGroup Test"
    default n
    help
        Select this option to enable bt's osi EventBitGroup test.

config BT_TEST_OSI_MUTEX_ENABLED
    bool "OSI Mutex Test"
    default n
    help
        Select this option to enable bt's osi mutex test.

config BT_TEST_OSI_HASH_MAP_ENABLED
    bool "OSI Hash Map Test"
    default n
    help
        Select this option to enable bt's osi Hash Map test.

config BT_TEST_OSI_FIXED_QUEUE_ENABLED
    bool "OSI Fiexed Queue Test"
    default n
    help
        Select this option to enable bt's osi Fiexed Queue test.

config BT_TEST_OSI_PKT_QUEUE_ENABLED
    bool "OSI Pkt Queue Test"
    default n
    help
        Select this option to enable bt's osi Pkt Queue test.

config BT_TEST_OSI_FIXED_PKT_QUEUE_ENABLED
    bool "OSI Fiexed Pkt Queue Test"
    default n
    help
        Select this option to enable bt's osi Fiexed Pkt Queue test.

config BT_TEST_OSI_ALARM_ENABLED
    bool "OSI Alarm Test"
    default n
    help
        Select this option to enable bt's osi Alarm test.

endif

config BT_TEST_BT_ENABLED
    bool "BT Test"
    help
        Select this option to enable bt's bt test.

if BT_TEST_OSI_ENABLED



endif
```
