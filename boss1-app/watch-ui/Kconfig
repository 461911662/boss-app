## boss1-app/watch-ui/Kconfig
```kconfig
#
# For a description of the syntax of this configuration file,
# see the file kconfig-language.txt in the NuttX tools repository.
#

config EXAMPLES_WATCHUI
	tristate "\"Watch UI\" example"
	default n
	---help---
		Enable the \"Watch UI\" example

if EXAMPLES_WATCHUI

config EXAMPLES_WATCHUI_PROGNAME
	string "Program name"
	default "watch_ui"
	---help---
		This is the name of the program that will be used when the NSH ELF
		program is installed.

config EXAMPLES_WATCHUI_PRIORITY
	int "Hello task priority"
	default 100

config EXAMPLES_WATCHUI_STACKSIZE
	int "Hello stack size"
	default DEFAULT_TASK_STACKSIZE

endif
```

## boss1-app/watch-ui/apps/face/Kconfig
```kconfig
#
# For a description of the syntax of this configuration file,
# see the file kconfig-language.txt in the NuttX tools repository.
#

config WATCH_UI_FACE
        tristate "WATCH UI FACE PROGRAM"
        default y
        depends on EXAMPLES_WATCHUI
        ---help---
                Enable support for Watch ui face.
```

## boss1-app/watch-ui/apps/login/Kconfig
```kconfig
#
# For a description of the syntax of this configuration file,
# see the file kconfig-language.txt in the NuttX tools repository.
#

config WATCH_UI_LOGIN
        tristate "WATCH UI LOGIN PROGRAM"
        default y
        depends on EXAMPLES_WATCHUI
        ---help---
                Enable support for Watch ui login.
```
